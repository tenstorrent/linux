// SPDX-License-Identifier: (GPL-2.0 OR MIT)
/dts-v1/;

#include "blackhole.dtsi"

/ {
	model = "Tenstorrent Blackhole";
	compatible = "tenstorrent,blackhole-card", "tenstorrent,blackhole";

	memory@400030000000 {
		device_type = "memory";
		reg = <0x4001 0x00000000 0x0 0x80000000>;
	};
};
