## Documentation/devicetree/bindings/pmem/pmem-region.yaml
```yaml
# SPDX-License-Identifier: (GPL-2.0-only OR BSD-2-Clause)
%YAML 1.2
---
$id: http://devicetree.org/schemas/pmem-region.yaml#
$schema: http://devicetree.org/meta-schemas/core.yaml#

maintainers:
  - Bjorn Helgaas <bhelgaas@google.com>
  - Oliver O'Halloran <oohall@gmail.com>

title: Persistent Memory Regions

description: |
  Device-tree bindings for persistent memory regions
  -----------------------------------------------------

  Persistent memory refers to a class of memory devices that are:

    a) Usable as main system memory (i.e. cacheable), and
    b) Retain their contents across power failure.

  Given b) it is best to think of persistent memory as a kind of memory mapped
  storage device. To ensure data integrity the operating system needs to manage
  persistent regions separately to the normal memory pool. To aid with that this
  binding provides a standardised interface for discovering where persistent
  memory regions exist inside the physical address space.

  Bindings for the region nodes:

properties:
  compatible:
    description: Device tree compatible string for persistent memory region nodes
    const: pmem-region

  reg:
    maxItems: 1

  volatile:
    description: Skip cache flushes for writes; indicates the region is volatile (non-persistent)
    type: boolean

required:
  - compatible
  - reg

additionalProperties: false

examples:
  - |
    pmem@5000 {
        compatible = "pmem-region";
        reg = <0x00005000 0x00001000>;
    };
```

## Documentation/devicetree/bindings/riscv/tenstorrent.yaml
```yaml
# SPDX-License-Identifier: (GPL-2.0-only OR BSD-2-Clause)
%YAML 1.2
---
$id: http://devicetree.org/schemas/riscv/tenstorrent.yaml#
$schema: http://devicetree.org/meta-schemas/core.yaml#

title: Tenstorrent SoC-based boards

maintainers:
  - Drew Fustini <dfustini@tenstorrent.com>

description:
  Tenstorrent SoC-based boards

properties:
  $nodename:
    const: '/'
  compatible:
    oneOf:
      - description: Tenstorrent Blackhole P100 card
        items:
          - const: tenstorrent,blackhole-p100
          - const: tenstorrent,blackhole

additionalProperties: true

...
```

## drivers/net/ethernet/tenstorrent/Kconfig
```kconfig
# SPDX-License-Identifier: GPL-2.0-only
#
# Tenstorrent network device configuration
#

config TTETH_NET
	tristate "Tenstorrent Blackhole Virtual Ethernet"
	default y
	help
	  Say Y or M here if you want to use the Tenstorrent Blackhole Virtual 
	  Ethernet Driver
```
